## drivers/input/fingerprint/focaltech/Kconfig
```kconfig
config FOCALTECH_FINGERPRINT
	tristate "generic focaltech fingerprint driver"
	default n
	help
	add support for focaltech fingerprint driver.
```
