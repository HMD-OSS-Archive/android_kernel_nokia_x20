## drivers/chino-e/Kconfig
```kconfig
#
# OEM device bootinfo configuration
#

config OEM_DEVINFO
    tristate "device boot info"
    help
	Say Y here if you want to enable device boot info.
	If unsure, say N.

source "drivers/chino-e/ontimdbgcore/Kconfig"
```

## drivers/input/fingerprint/Kconfig
```kconfig
#
#Fingerprint
#
menuconfig INPUT_FINGERPRINT
       tristate "Fingerprint Config Choosen"
	   default y
	   help
	   Say Y to can config fingerprint manufacturer

config HS_FINGERPRINT
	tristate "fingerprint drvier support"
	help
	  Say Y here to enable fingerprint driver support!

config FINGERPRINT_GOODIX
	tristate "generic goodix fingerprint driver"
	help
	add support for goodix fingerprint driver.


source "drivers/input/fingerprint/cdfingerfp/Kconfig"
source "drivers/input/fingerprint/fpr_FingerprintCard/Kconfig"
source "drivers/input/fingerprint/fpsensor/Kconfig"
```

## drivers/input/fingerprint/cdfingerfp/Kconfig
```kconfig
config CDFINGER_FP 
       tristate "cdfinger fingerprint deiver support"
       help
         Say Y here to enable cdfinger fingerprint driver support!
```

## drivers/input/touchscreen/FT8756/Kconfig
```kconfig
#
# Focaltech Touchscreen driver configuration
#

config TOUCHSCREEN_FT8756
    tristate "Focaltech Touchscreen"
    help
	Say Y here if you have Focaltech touch panel.
	If unsure, say N.

config TOUCHSCREEN_FTS_DIRECTORY
    string "Focaltech ts directory name"
    default "FT8756"
    depends on TOUCHSCREEN_FT8756
    
```

## drivers/input/touchscreen/focaltech_thething/Kconfig
```kconfig
#
# Focaltech Touchscreen driver configuration
#

config TOUCHSCREEN_FTS_THETHING
	tristate "Focaltech Touchscreen"
	help
	  Say Y here if you have Focaltech touch panel.
	  If unsure, say N.

config TOUCHSCREEN_FTS_DIRECTORY
	string "Focaltech ts directory name"
	default "focaltech_touch"
	depends on TOUCHSCREEN_FTS_THETHING

config TOUCHSCREEN_FTS_KERNEL_READ_FW
	bool "FocalTech touchscreens kernel read firmware function"
	depends on TOUCHSCREEN_FTS_THETHING
	help
	  Say Y here if you need a Focaltech touchscreen kernel read firmware function.
	  else say N

config FT_INCELL_CHIP
	bool "FocalTech incell touchscreens support."
	depends on TOUCHSCREEN_FTS_THETHING
	help
	  Say Y here if you use a incell focaltech touchscreen.
	  else say N

config TOUCHSCREEN_FT_SPI_FH
	bool "FocalTech touchscreens FH support."
	depends on TOUCHSCREEN_FTS_THETHING
	help
	  Say Y here if you need a ft5X06 touchscreen FH function.
	  else say N

config TOUCHSCREEN_FT_SPI_GESTURE
	bool "FocalTech touchscreens gesture function"
	depends on TOUCHSCREEN_FTS_THETHING
	help
	  Say Y here if you need a ft8006p touchscreen gesture function.
	  else say N

config TOUCHSCREEN_FT_SPI_GLOVE
	bool "FocalTech touchscreens glove mode function realized in driver"
	depends on TOUCHSCREEN_FTS_THETHING
	help
	  Say Y here if you need a ft8xxx glove mode in driver.
	  else say N

#endif
```

## drivers/input/touchscreen/ft8719_spi/Kconfig
```kconfig
#
# Focaltech Touchscreen driver configuration
#

config TOUCHSCREEN_FT8719_SPI
	tristate "Focaltech Touchscreen test"
	depends on SPI_MASTER
	help
	  Say Y here if you have Focaltech touch panel.

	  If unsure, say N.

	  To compile this driver as a module, choose M here: the
	  module will be called focal_spi_ts.
    
config FT_8719_INCELL_CHIP
	bool "FocalTech incell touchscreens support."
	depends on TOUCHSCREEN_FT8719_SPI
	help
	  Say Y here if you use a incell focaltech touchscreen.
	  else say N

config TOUCHSCREEN_FT8719_SPI_FH
	bool "FocalTech touchscreens FH support."
	depends on TOUCHSCREEN_FT8719_SPI
	help
	  Say Y here if you need a ft5X06 touchscreen FH function.
	  else say N

config TOUCHSCREEN_FT8719_SPI_GESTURE
	bool "FocalTech touchscreens gesture function"
	depends on TOUCHSCREEN_FT8719_SPI
	help
	  Say Y here if you need a ft8006p touchscreen gesture function.
	  else say N
config FT8719_FTS_DEBUG_EN
	bool "FocalTech touchscreens used to print debug log info function"
	depends on TOUCHSCREEN_FT8719_SPI
	default n
	help
	  Say Y here if you need to print debug log info in debug version.
	  else say N

config FT8719_FTS_MT_PROTOCOL_B_EN
	bool "FocalTech touchscreens used protocol A or B function"
	depends on TOUCHSCREEN_FT8719_SPI
	default n
	help
	  Say Y here if using protocol B.
	  else say N

config TOUCHSCREEN_FT8719_SPI_GLOVE
	bool "FocalTech touchscreens glove mode function realized in driver"
	depends on TOUCHSCREEN_FT8719_SPI
	help
	  Say Y here if you need a ft8xxx glove mode in driver.
	  else say N
```

## drivers/misc/checksdcard/Kconfig
```kconfig
config SDCARD_REPORT 
	bool "sdcard status report virtual pin"
	default n
	help
		this feature is for reporting sdcars status
```

## drivers/misc/st21nfc/Kconfig
```kconfig
# SPDX-License-Identifier: GPL-2.0-only

config NFC_ST21NFC
	tristate "STMicroelectronics ST21NFC NFC driver (I2C)"
	default n
	---help---
	  This module adds support for the STMicroelectronics st21nfc i2c interface.
	  Select this if your platform is using the i2c bus.

	  If you choose to build a module, it'll be called st21nfc_i2c.
	  Say N if unsure.
```

## drivers/soc/hs/Kconfig
```kconfig
source "drivers/soc/hs/base/Kconfig"

source "drivers/soc/hs/efuse/Kconfig"

source "drivers/soc/hs/pm/Kconfig"

source "drivers/soc/hs/mm/Kconfig"

source "drivers/soc/hs/audio/Kconfig"
```

## drivers/soc/hs/audio/Kconfig
```kconfig
config TTG_ACCESS_DIAG_PARTITION
	bool "get info from diag partition"
	help
	  Provide a methed to get info from diag partition.
```

## drivers/soc/hs/base/Kconfig
```kconfig
comment "HS product Infomation"

config HS_PRODUCT_DEVINFO
	tristate "device info register of product"
	help
	  Provide a methed to register the peripheral device
	  infomation of product.

config HS_DEBUG_CTRL
	tristate "HS debug method"
	help
	  Say Y when you need debug your device.
```

## drivers/soc/hs/efuse/Kconfig
```kconfig
config QCOM_CHIP_EFUSE
	tristate "read the fuse status for qcom chip"
	depends on HS_PRODUCT_DEVINFO
	help
	  add the fuse status node to read qcom chip efuse status
```

## drivers/soc/hs/mm/Kconfig
```kconfig
config TTG_BOOT_INFO
	bool "thething Boot information"
	help
	  The information of booting system
```

## drivers/soc/hs/pm/Kconfig
```kconfig
config HS_PM_DEBUG
	tristate "HS pm debug"
	help
	  print clk, gpio, vreg status when the device enter suspend mode.
```

## kernel/printk/Kconfig
```kconfig
menu "HMD HELP"
config PRINTK_HMD_PREFIX
	bool "Prefix cpu_id/status/pid/process_name/UTC to each kernel log"
	default n
	help
	  PRINTK_HMD_PREFIX which is used to control whether to show
	  process information about this log.
	  the information about which cpu about this
	  process in, and whether in isr.

config HMD_PRINTK_UART_CONSOLE
	bool "HMD printk UART controller"
	default n
	help
	  HMD_PRINTK_UART_CONSOLE which is used to control whether to
	  control printk to uart console.  when boot up finish
	  uart console do not output printk log.
	  also RD can set the setting by command.

config HMD_PRINTK_UART_CONSOLE_DEFAULT_Y
	bool "HMD printk UART controller default value"
	default n
	help
	  HMD_PRINTK_UART_CONSOLE_DEFAULT_Y which is used to control whether to
	  printk to uart console.  when boot up finish
	  uart console do not output printk log.
	  also RD can set the setting by command.
	  y means enable uart log after boot.
	  n means disable uart log after boot.

endmenu
```

## tinno/common_features/Kconfig
```kconfig
config TINNO_PRODUCT_INFO
    bool "TINNO_PRODUCT_INFO"
    default y
    
config TINNO_TP_GESTURE
    bool "TINNO_TP_GESTURE"
    default n
```
